## CMakeLists.txt
```
# SPDX-License-Identifier: Apache-2.0

cmake_minimum_required(VERSION 3.13.1)
find_package(Zephyr HINTS $ENV{ZEPHYR_BASE})
project(audio_sof)

FILE(GLOB app_sources src/*.c)
target_sources(app PRIVATE ${app_sources})

set(sof_module ${ZEPHYR_BASE}/../modules/audio/sof)

# Needed for using SOF headers
target_include_directories(app PRIVATE ${sof_module}/zephyr/include)
target_include_directories(app PRIVATE ${sof_module}/src/include)
target_include_directories(app PRIVATE ${sof_module}/src/arch/xtensa/include)
```

## prj.conf
```kconfig
CONFIG_ZTEST=y
CONFIG_SOF=y
CONFIG_HEAP_MEM_POOL_SIZE=256
```

## src/main.c
```c
/*
 * Copyright (c) 2020 Intel Corporation
 *
 * SPDX-License-Identifier: Apache-2.0
 */

#include <ztest.h>

extern void test_audio_sof_alloc(void);
extern void test_audio_sof_rzalloc(void);

/*test case main entry*/
void test_main(void)
{
	ztest_test_suite(audio_sof,
			 ztest_unit_test(test_audio_sof_alloc),
			 ztest_unit_test(test_audio_sof_rzalloc));
	ztest_run_test_suite(audio_sof);
}
```

## src/test_audio_sof_alloc.c
```c
/*
 * Copyright (c) 2016 Intel Corporation
 *
 * SPDX-License-Identifier: Apache-2.0
 */

#include <ztest.h>

/**
 * This should be included from
 *
 * #include <sof/lib/alloc.h>
 *
 * but it triggers include chain issue.
*/

#define SOF_MEM_CAPS_RAM                        (1 << 0)

enum mem_zone {
        SOF_MEM_ZONE_SYS = 0,           /**< System zone */
        SOF_MEM_ZONE_SYS_RUNTIME,       /**< System-runtime zone */
        SOF_MEM_ZONE_RUNTIME,           /**< Runtime zone */
        SOF_MEM_ZONE_BUFFER,            /**< Buffer zone */
};

void *rmalloc(enum mem_zone zone, uint32_t flags, uint32_t caps, size_t bytes);
void *rzalloc(enum mem_zone zone, uint32_t flags, uint32_t caps, size_t bytes);
void rfree(void *ptr);

#define BLK_SIZE_MIN 64
#define BLK_NUM_MAX (CONFIG_HEAP_MEM_POOL_SIZE / BLK_SIZE_MIN)
#define BLK_NUM_MIN (CONFIG_HEAP_MEM_POOL_SIZE / (BLK_SIZE_MIN << 2))

/* Use SOF_MEM_ZONE_BUFFER */

/**
 * Test rmalloc() and rfree() API functionality
 */
void test_audio_sof_alloc(void)
{
	void *block[2 * BLK_NUM_MAX], *block_fail;
	int nb;

	for (nb = 0; nb < ARRAY_SIZE(block); nb++) {
		block[nb] = rmalloc(SOF_MEM_ZONE_BUFFER, 0, SOF_MEM_CAPS_RAM,
				    BLK_SIZE_MIN);
		if (block[nb] == NULL) {
			break;
		}
	}

	block_fail = rmalloc(SOF_MEM_ZONE_BUFFER, 0, SOF_MEM_CAPS_RAM,
			     BLK_SIZE_MIN);
	/* Return NULL if fail.*/
	zassert_is_null(block_fail, NULL);

	for (int i = 0; i < nb; i++) {
		rfree(block[i]);
	}

	/* If ptr is NULL, no operation is performed.*/
	rfree(NULL);
}

#define SIZE    256

/**
 * Test to demonstrate rzalloc() API functionality.
 */
void test_audio_sof_rzalloc(void)
{
	char *mem;

	mem = rzalloc(SOF_MEM_ZONE_BUFFER, 0, SOF_MEM_CAPS_RAM, SIZE);

	zassert_not_null(mem, "calloc operation failed");

	/* Memory should be zeroed and not crash us if we read/write to it */
	for (int i = 0; i < SIZE; i++) {
		zassert_equal(mem[i], 0, NULL);
		mem[i] = 1;
	}

	rfree(mem);
}
```

## src/test_audio_sof_irq.c
```c
/*
 * Copyright (c) 2020 Intel Corporation
 *
 * SPDX-License-Identifier: Apache-2.0
 */

/* The test origin is dynamic_isr.c adapted for SOF API testing */

#include <ztest.h>
extern struct _isr_table_entry __sw_isr_table _sw_isr_table[];
extern void z_irq_spurious(void *unused);

static void dyn_isr(void *arg)
{
	ARG_UNUSED(arg);
}

/* TODO: Include tight header */
int interrupt_register(uint32_t irq, void(*handler)(void *arg), void *arg);

/**
 * Test dynamic ISR installation
 *
 * This routine locates an unused entry in the software ISR table, installs a
 * dynamic ISR to the unused entry by calling the `arch_irq_connect_dynamic`
 * function, and verifies that the ISR is successfully installed by checking
 * the software ISR table entry.
 */
void test_audio_sof_irq(void)
{
	int i;
	void *argval;

	for (i = 0; i < (CONFIG_NUM_IRQS - CONFIG_GEN_IRQ_START_VECTOR); i++) {
		if (_sw_isr_table[i].isr == z_irq_spurious) {
			break;
		}
	}

	zassert_true(_sw_isr_table[i].isr == z_irq_spurious,
		     "could not find slot for dynamic isr");

	TC_PRINT("Installing dynamic ISR for IRQ %d\n",
		 CONFIG_GEN_IRQ_START_VECTOR + i);

	argval = &i;
	interrupt_register(i + CONFIG_GEN_IRQ_START_VECTOR, dyn_isr, argval);

	zassert_true(_sw_isr_table[i].isr == dyn_isr &&
		     _sw_isr_table[i].arg == argval,
		     "dynamic isr did not install successfully");
}
```

## src/test_audio_sof_sched.c
```c
/*
 * Copyright (c) 2020 Intel Corporation
 *
 * SPDX-License-Identifier: Apache-2.0
 */

#include <ztest.h>

/*
 * Including the header below trigger include chain issue
 */
enum mem_zone {
        SOF_MEM_ZONE_SYS = 0,           /**< System zone */
        SOF_MEM_ZONE_SYS_RUNTIME,       /**< System-runtime zone */
        SOF_MEM_ZONE_RUNTIME,           /**< Runtime zone */
        SOF_MEM_ZONE_BUFFER,            /**< Buffer zone */
};

void *rzalloc(enum mem_zone zone, uint32_t flags, uint32_t caps, size_t bytes);

/**
 * Safe to include headers
 */
#include <sof/list.h>
#include <sof/schedule/task.h>
#include <sof/schedule/schedule.h>

int schedule_task_init_edf(struct task *task, uint32_t uid,
			   const struct task_ops *ops,
			   void *data, uint16_t core, uint32_t flags);

#define SOF_UUID(uuid_name) 0

static enum task_state test_task(void *data)
{
	struct k_sem *sem = data;

	TC_PRINT("Task %s running\n", __func__);

	k_sem_give(sem);

	return SOF_TASK_STATE_COMPLETED;
}

static uint64_t task_main_deadline(void *data)
{
	return SOF_TASK_DEADLINE_IDLE;
}

struct task_ops ops = {
	.run = test_task,
	.get_deadline = task_main_deadline,
};

static bool test_task_init(struct task **task, void *data)
{
	int ret;

	TC_PRINT("Initializing task\n");

	*task = rzalloc(SOF_MEM_ZONE_SYS, 0, 0, sizeof(**task));
	zassert_not_null(*task, "Memory allocation failed");

	ret = schedule_task_init_edf(*task, SOF_UUID(main_task_uuid),
				     &ops, data, 0, 0);
	zassert_equal(ret, 0, "Task init failed");

	return ret;
}

static struct k_sem task_sync_sem;

void test_audio_sof_sched_edf(void)
{
	struct task *task;
	int ret;

	ret = k_sem_init(&task_sync_sem, 0, 1);
	zassert_equal(ret, 0, "Semaphore initialization failed");

	ret = test_task_init(&task, &task_sync_sem);

	ret = schedule_task(task, 0, 0);
	zassert_equal(ret, 0, "Scheduling task failed");

	/* Wait for task */
	k_sem_take(&task_sync_sem, K_FOREVER);
}
```

/*
 * Copyright (c) 2020 Intel Corporation
 *
 * SPDX-License-Identifier: Apache-2.0
 */

/dts-v1/;

#include <intel/intel_apl_adsp.dtsi>

/ {
	model = "up_xtreme_adsp";
	compatible = "intel";

	chosen {
		zephyr,sram = &sram0;
	};
};

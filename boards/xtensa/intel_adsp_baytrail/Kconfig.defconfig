## boards/xtensa/intel_adsp_baytrail/Kconfig.defconfig
```kconfig
# Copyright (c) 2020 Intel Corporation
#
# SPDX-License-Identifier: Apache-2.0

if BOARD_INTEL_ADSP_BAYTRAIL

config BOARD
	default "intel_adsp_baytrail"

config CAVS_ICTL_0_OFFSET
	default 6
config CAVS_ICTL_1_OFFSET
	default 10
config CAVS_ICTL_2_OFFSET
	default 13
config CAVS_ICTL_3_OFFSET
	default 16

config MAX_IRQ_PER_AGGREGATOR
	default 32

config HEAP_MEM_POOL_SIZE
	default 1024
	depends on DMA_DW

config DMA_DW
	default y
	depends on DMA

config I2S_CAVS
	default y
	depends on I2S

config HEAP_MEM_POOL_SIZE
	default 196608
	depends on SOF

endif # BOARD_INTEL_ADSP_BAYTRAIL
```

## boards/xtensa/up_xtreme_adsp/Kconfig.board
```kconfig
# Xtensa board configuration

# Copyright (c) 2020 Intel Corporation
# SPDX-License-Identifier: Apache-2.0

config  BOARD_UP_XTREME_ADSP
	bool "Xtensa on Up Xtreme"
	depends on SOC_SERIES_INTEL_CAVS_V18
```

## soc/xtensa/intel_adsp/Kconfig
```kconfig
# Intel CAVS SoC family configuration options
#
# Copyright (c) 2020 Intel Corporation
# SPDX-License-Identifier: Apache-2.0

config SOC_FAMILY_INTEL_ADSP
	bool

if SOC_FAMILY_INTEL_ADSP

config SOC_FAMILY
	string
	default "intel_adsp"

config ADSP_LOG_WIN_BASE
	hex "Address of host logging window"
	default 0x9e008000
	help
	  Address in the aDSP memory space of the HPSRAM memory which
	  holds the logging ring buffer.  Note that the printk layer
	  expects this memory to be coherent in MP environments!  When
	  used with more than one CPU, it should point into the
	  uncached mapping of HP-SRAM.

config ADSP_LOG_WIN_SIZE
	int "Size of host logging window"
	default 8192
	help
	  Size in bytes of the host logging memory

# Select SoC Part No. and configuration options
source "soc/xtensa/intel_adsp/*/Kconfig.soc"

endif # SOC_FAMILY_INTEL_ADSP
```

## soc/xtensa/intel_apl_adsp/Kconfig.defconfig
```kconfig
# Kconfig - XTENSA board configuration
#
# Copyright (c) 2017 Intel Corporation
# SPDX-License-Identifier: Apache-2.0

if SOC_INTEL_APL_ADSP

config SOC
	string
	default "intel_apl_adsp"

config IRQ_OFFLOAD_INTNUM
	default 0

# S1000 does not have MISC0.
# Since EXCSAVE2 is unused by Zephyr, use it instead.
config XTENSA_KERNEL_CPU_PTR_SR
	default "EXCSAVE2"

config KERNEL_ENTRY
	default "_MainEntry" if USE_SOF_BOOT_LDR

config USE_SOF_BOOT_LDR
	default y

if SOF

config MULTI_LEVEL_INTERRUPTS
	default y

config 2ND_LEVEL_INTERRUPTS
	default y

config DYNAMIC_INTERRUPTS
	default y

endif

if LOG

config LOG_BACKEND_ADSP
	default y

config LOG_BACKEND_ADSP_RINGBUF_BASE
	default "0xBE008000"

config LOG_BACKEND_ADSP_RINGBUF_SIZE
	default "0x2000"

endif # LOG

endif
```
